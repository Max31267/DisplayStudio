## firmware/main/Kconfig.projbuild
```kconfig
menu "Mini Display ST7789"
    config MD_PIN_SCLK
        int "SPI SCLK GPIO"
        range 0 10
        default 4
    config MD_PIN_MOSI
        int "SPI MOSI GPIO"
        range 0 10
        default 6
    config MD_PIN_CS
        int "CS GPIO (-1 if panel has no CS)"
        range -1 10
        default 7
    config MD_PIN_DC
        int "DC GPIO"
        range 0 10
        default 1
    config MD_PIN_RST
        int "RESET GPIO (-1 if unused)"
        range -1 10
        default 3
    config MD_PIN_BL
        int "Backlight enable GPIO (-1: external wiring)"
        range -1 10
        default -1
    config MD_BL_ACTIVE_HIGH
        bool "Backlight enable is active high"
        default y
    config MD_SPI_MHZ
        int "SPI clock MHz"
        range 1 40
        default 20
    config MD_GAP_X
        int "Panel X gap"
        range 0 80
        default 0
    config MD_GAP_Y
        int "Panel Y gap"
        range 0 80
        default 0
    config MD_BGR
        bool "Use BGR color order"
        default n
    config MD_INVERT
        bool "Invert panel colors"
        default y
    config MD_SWAP_XY
        bool "Swap X and Y"
        default n
    config MD_MIRROR_X
        bool "Mirror X"
        default n
    config MD_MIRROR_Y
        bool "Mirror Y"
        default n
endmenu
```

## firmware/sdkconfig.defaults
```kconfig
CONFIG_IDF_TARGET="esp32c3"
CONFIG_ESPTOOLPY_FLASHSIZE_4MB=y
CONFIG_ESP_CONSOLE_UART_DEFAULT=y
# CONFIG_ESP_CONSOLE_USB_SERIAL_JTAG is not set
CONFIG_ESP_CONSOLE_SECONDARY_NONE=y
CONFIG_ESP_MAIN_TASK_STACK_SIZE=6144
CONFIG_LOG_DEFAULT_LEVEL_WARN=y
CONFIG_PARTITION_TABLE_SINGLE_APP=y
# CONFIG_PM_ENABLE is not set
CONFIG_MD_PIN_BL=5
CONFIG_MD_BL_ACTIVE_HIGH=y
CONFIG_MD_BL_DEFAULT_PERCENT=80
```
